## conf/distro/mypoky.conf
```bitbake
#Distro configuration
require conf/distro/poky.conf
DISTRO = "mypoky"
DISTROOVERRIDES = "poky:mypoky"
DISTRO_VERSION = "1.0.0"
DISTRO_NAME ?= "mjj (Reference Distro)"
PACKAGE_CLASSES ?= "package_ipk"

# Use systemd init manager.
#DISTRO_FEATURES_remove = "sysvinit"
DISTRO_FEATURES:append = " systemd"
VIRTUAL-RUNTIME_init_manager = "systemd"
DISTRO_FEATURES_BACKFILL_CONSIDERED += "sysvinit"
```
